AUTOSAR XML (schema 4-2-2)
package /ActiveEcuC
  module config ComM: implementation-config-variant=VARIANT-PRE-COMPILE, module-description=ComM_Impl
    ComMGeneral:
      ComMPncIdCounting = COMM_PNC_ID_COUNT_FROM_NM_MESSAGE
      ComMPncSupport = false
      ComMDevErrorDetect = true
      ComMEcuGroupClassification = 3
      ComMModeLimitationEnabled = false
      ComMSynchronousWakeUp = true
      ComMTMinFullComModeDuration = 5
      ComMVersionInfoApi = false
      ComMWakeupInhibitionEnabled = false
      ComMSafeBswChecks = false
      ComMGeneration: ComMOutOfBoundsWriteSanitizer=false, ComMOutOfBoundsReadSanitizer=false
    ComMConfigSet: ComMPncEnabled=false
      Connector_eJAD_AC_ECU_5f730b4d60fd8937_17d2a688 (ComMChannel):
        ComMBusType = COMM_BUS_TYPE_CAN
        ComMChannelId = 0
        ComMFullCommRequestNotificationEnabled = false
        ComMMainFunctionPeriod = 0.02
        ComMNoCom = false
        ComMNoWakeup = false
        ComMNetworkManagement: ComMNmVariant=NONE, ComMPncNmRequest=false
        Connector_eJAD_AC_ECU_5f730b4d60fd8937_76433822 (ComMUserPerChannel): ComMUserChannel=Connector_eJAD_AC_ECU_5f730b4d60fd8937_1ac2290f
      Connector_eJAD_AC_ECU_5f730b4d60fd8937_1ac2290f (ComMUser): ComMUserIdentifier=0, ComMUserModeNotification=false

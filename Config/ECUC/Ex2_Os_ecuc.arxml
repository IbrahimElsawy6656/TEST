AUTOSAR XML (schema 4-2-2)
package /ActiveEcuC
  module config Os: implementation-config-variant=VARIANT-PRE-COMPILE, module-description=Os_Impl
    OsPublishedInformation: OsKernelVersion=7, OsPlatformName=TriCoreAurix
      TC39x (OsDerivativeInformation):
        OsMpuAlignment = 8
        OsStackAlignment = 8
        OsExceptionVectorTableAlignment = 32
        OsInterruptVectorTableAlignment = 32
        OsHardwareManuals = User Manual: TC3XX_ts__TargetSpec_rev1v3v0.pdf V1.3.0, 2016-02 Errata Sheet: TC39x AA_Errata_Sheet_rev1v0_2016-06-08.pdf Rel. 1.0, 2016-06-08
        STM0 (OsHardwareTimer): OsHardwareTimerSize=32, OsHardwareTimerUnit=FRT, OsHardwareTimerBaseAddress=4026535936, OsHardwareTimerId=0, OsHardwareTimerType=STM
          STM0_Ch0 (OsHardwareTimerChannel): OsHardwareTimerChannelIntSource=768, OsHardwareTimerChannelOffset=0, OsHardwareTimerChannelId=0
          STM0_Ch1 (OsHardwareTimerChannel): OsHardwareTimerChannelIntSource=772, OsHardwareTimerChannelOffset=1, OsHardwareTimerChannelId=1
        GPT (OsHardwareTimer): OsHardwareTimerSize=16, OsHardwareTimerUnit=PIT, OsHardwareTimerBaseAddress=4026537984, OsHardwareTimerId=0, OsHardwareTimerType=PIT
          GPT_Ch0 (OsHardwareTimerChannel): OsHardwareTimerChannelIntSource=744, OsHardwareTimerChannelOffset=0, OsHardwareTimerChannelId=0
          GPT_Ch1 (OsHardwareTimerChannel): OsHardwareTimerChannelIntSource=756, OsHardwareTimerChannelOffset=1, OsHardwareTimerChannelId=1
        AURIXTC3XX_IR (OsSystemIntCtrl): OsSystemIntCtrlMaxPrios=255, OsSystemIntCtrlPrioOrder=ASC, OsSystemIntCtrlMaxSources=8192, OsSystemIntCtrlBaseAddress=4026757120
        DMA (OsInterruptSupportedType): OsInterruptSupportedTypeSeparateSources=false, OsInterruptSupportedTypeSeparatePriority=true
        Core0 (OsPhysicalCore):
          OsPhysicalCoreId = 0
          OsPhysicalCoreDefaultEntrySymbol = _start_tc0
          OsPhysicalCoreType = TC1.6.2P
          OsPhysicalCoreExceptionSources = 8
          OsPhysicalCoreMasterStartAllowed = true
          OsPhysicalCorePrivelegedHwAccess = true
          OsPhysicalCoreIsAutostart = true
          OsPhysicalCoreStackProtectionUnit = OsPhysicalCore0DataMpu
          OsPhysicalCore0DataMpu (OsPhysicalCoreMpu): OsPhysicalCoreMpuId=0, OsPhysicalCoreMpuMaxRegions=18, OsPhysicalCoreMpuType=DATA
          OsPhysicalCore0CodeMpu (OsPhysicalCoreMpu): OsPhysicalCoreMpuId=1, OsPhysicalCoreMpuMaxRegions=10, OsPhysicalCoreMpuType=CODE
        OsMemoryRegionSpecifics
          3 x OsMemoryRegionAccess, all with OsMemoryRegionAccessType=PROTECTION_SET0:
            PS0_W: OsMemoryRegionAccessRights=W
            PS0_R: OsMemoryRegionAccessRights=R
            PS0_X: OsMemoryRegionAccessRights=X
        DEFAULT (OsInterruptSupportedType): OsInterruptSupportedTypeSeparateSources=false, OsInterruptSupportedTypeSeparatePriority=false
    OSDEFAULTAPPMODE (OsAppMode)
    OsOS:
      OsStackMonitoring = true
      OsStatus = EXTENDED
      OsUseGetServiceId = false
      OsUseParameterAccess = false
      OsUseResScheduler = false
      OsForcibleTermination = false
      OsGenerateCalloutStubs = true
      OsGenerateMemMap = COMPLETE
      OsGenerateMemMapForNearAddressing = true
      OsGenerateMemMapForThreads = false
      OsServiceProtection = false
      OsStackUsageMeasurement = false
      OsUseXSignalAsyncApiCalls = false
      OsFpuUsage = NONE
      OsScalabilityClass = SC1
      OsMasterCore = (unset)
      OsSystemTimer = SystemTimer
      OsStackSummary
      OsHooks: OsErrorHook=true, OsPostTaskHook=false, OsPreTaskHook=false, OsShutdownHook=false, OsStartupHook=false
    SystemTimer (OsCounter): OsCounterMaxAllowedValue=2147483647, OsCounterMinCycle=1, OsCounterType=HARDWARE, OsSecondsPerTick=0.001, OsCounterTicksPerBase=1
      OsDriver: OsDriverHighResolution=false, OsDriverHardwareTimerChannelRef=GPT_Ch0, OsDriverIsrRef=(unset)
    OsMemoryProtection
      24 x OsMemoryRegion:
        EXC_ALL_Core{0..2}: OsMemoryRegionStartAddress=0, OsMemoryRegionEndAddress=0xFFFFFFFF, OsMemoryRegionProtectionUnit=OsPhysicalCore{0..2}CodeMpu, OsMemoryRegionAccessRights=PS0_X, OsMemoryRegionAccessRights=PS1_X, OsMemoryRegionAccessRights=PS2_X, OsMemoryRegionAccessRights=PS3_X, OsMemoryRegionAccessRights=PS4_X, OsMemoryRegionAccessRights=PS5_X
        READ_ALL_Core{0..2}: OsMemoryRegionStartAddress=0, OsMemoryRegionEndAddress=0xFFFFFFFF, OsMemoryRegionProtectionUnit=OsPhysicalCore{0..2}DataMpu, OsMemoryRegionAccessRights=PS0_R, OsMemoryRegionAccessRights=PS1_R, OsMemoryRegionAccessRights=PS2_R, OsMemoryRegionAccessRights=PS3_R, OsMemoryRegionAccessRights=PS4_R, OsMemoryRegionAccessRights=PS5_R
        TRUSTED_WRITE_SPR_Core0: OsMemoryRegionEndAddress=0x7FFFFFFF, OsMemoryRegionStartAddress=_OS_CORE0_STACKS_END, OsMemoryRegionProtectionUnit=OsPhysicalCore0DataMpu, OsMemoryRegionAccessRights=PS0_W
        TRUSTED_WRITE_SPR_Core1: OsMemoryRegionEndAddress=0x6FFFFFFF, OsMemoryRegionStartAddress=_OS_CORE1_STACKS_END, OsMemoryRegionProtectionUnit=OsPhysicalCore1DataMpu, OsMemoryRegionAccessRights=PS0_W
        TRUSTED_WRITE_SPR_Core2: OsMemoryRegionEndAddress=0x5FFFFFFF, OsMemoryRegionStartAddress=_OS_CORE2_STACKS_END, OsMemoryRegionProtectionUnit=OsPhysicalCore2DataMpu, OsMemoryRegionAccessRights=PS0_W
        TRUSTED_WRITE_ALL_Core{0..2}: OsMemoryRegionStartAddress=0x80000000, OsMemoryRegionEndAddress=0xFFFFFFFF, OsMemoryRegionProtectionUnit=OsPhysicalCore{0..2}DataMpu, OsMemoryRegionAccessRights=PS0_W
        EXC_ALL_Core{3..5}: OsMemoryRegionStartAddress=0, OsMemoryRegionEndAddress=0xFFFFFFFF, OsMemoryRegionProtectionUnit=OsPhysicalCore{3..5}CodeMpu, OsMemoryRegionAccessRights=PS0_X, OsMemoryRegionAccessRights=PS1_X, OsMemoryRegionAccessRights=PS2_X, OsMemoryRegionAccessRights=PS3_X, OsMemoryRegionAccessRights=PS4_X, OsMemoryRegionAccessRights=PS5_X
        READ_ALL_Core{3..5}: OsMemoryRegionStartAddress=0, OsMemoryRegionEndAddress=0xFFFFFFFF, OsMemoryRegionProtectionUnit=OsPhysicalCore{3..5}DataMpu, OsMemoryRegionAccessRights=PS0_R, OsMemoryRegionAccessRights=PS1_R, OsMemoryRegionAccessRights=PS2_R, OsMemoryRegionAccessRights=PS3_R, OsMemoryRegionAccessRights=PS4_R, OsMemoryRegionAccessRights=PS5_R
        TRUSTED_WRITE_SPR_Core3: OsMemoryRegionEndAddress=0x4FFFFFFF, OsMemoryRegionStartAddress=_OS_CORE3_STACKS_END, OsMemoryRegionProtectionUnit=OsPhysicalCore3DataMpu, OsMemoryRegionAccessRights=PS0_W
        TRUSTED_WRITE_SPR_Core4: OsMemoryRegionEndAddress=0x3FFFFFFF, OsMemoryRegionStartAddress=_OS_CORE4_STACKS_END, OsMemoryRegionProtectionUnit=OsPhysicalCore4DataMpu, OsMemoryRegionAccessRights=PS0_W
        TRUSTED_WRITE_SPR_Core5: OsMemoryRegionEndAddress=0x1FFFFFFF, OsMemoryRegionStartAddress=_OS_CORE5_STACKS_END, OsMemoryRegionProtectionUnit=OsPhysicalCore5DataMpu, OsMemoryRegionAccessRights=PS0_W
        TRUSTED_WRITE_ALL_Core{3..5}: OsMemoryRegionStartAddress=0x80000000, OsMemoryRegionEndAddress=0xFFFFFFFF, OsMemoryRegionProtectionUnit=OsPhysicalCore{3..5}DataMpu, OsMemoryRegionAccessRights=PS0_W

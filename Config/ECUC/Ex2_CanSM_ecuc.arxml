AUTOSAR XML (schema 4-2-2)
package /ActiveEcuC
  module config CanSM: implementation-config-variant=VARIANT-PRE-COMPILE, module-description=CanSM_Impl
    CanSMConfiguration: CanSMModeRequestRepetitionMax=10, CanSMModeRequestRepetitionTime=0.1
      CAR_BackBone_becaaf5c (CanSMManagerNetwork):
        CanSMBorCounterL1ToL2 = 5
        CanSMBorTimeL1 = 1
        CanSMBorTimeL2 = 3
        CanSMBorTimeTxEnsured = 5
        CanSMBorTxConfirmationPolling = false
        CanSMComMNetworkHandleRef = Connector_eJAD_AC_ECU_5f730b4d60fd8937_17d2a688
        Controller_eJAD_AC_ECU_7f252cc98424769f_96f26c3c (CanSMController): CanSMControllerId=Controller_eJAD_AC_ECU_7f252cc98424769f_6e3aa728
    CanSMGeneral: CanSMDevErrorDetect=true, CanSMMainFunctionTimePeriod=0.01, CanSMVersionInfoApi=false, CanSMBorCheckLevel=false, CanSMSetBaudrateApi=false
      CanSMGeneration: CanSMOutOfBoundsWriteSanitizer=false, CanSMOutOfBoundsReadSanitizer=false

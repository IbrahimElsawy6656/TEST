AUTOSAR XML (schema 4-2-2)
package /ActiveEcuC
  module config ComXf: implementation-config-variant=VARIANT-PRE-COMPILE, module-description=ComXf_Impl
    XfrmGeneral: XfrmDevErrorDetect=true, XfrmVersionInfoApi=false

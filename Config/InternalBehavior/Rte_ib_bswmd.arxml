AUTOSAR XML (schema 4-2-2)
package /MICROSAR/Rte_ib_bswmd/BswModuleDescriptions
  bsw module description Rte
    bsw internal behavior RteBehavior
